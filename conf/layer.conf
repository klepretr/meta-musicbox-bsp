## conf/layer.conf
```bitbake
# We have a conf and classes directory, append to BBPATH
BBPATH .= ":${LAYERDIR}"

# We have a recipes directory containing .bb and .bbappend files, add to BBFILES
BBFILES += "${LAYERDIR}/recipes*/*/*.bb \
            ${LAYERDIR}/recipes*/*/*.bbappend"

BBFILE_COLLECTIONS += "musicbox-bsp"
BBFILE_PATTERN_musicbox-bsp := "^${LAYERDIR}/"
BBFILE_PRIORITY_musicbox-bsp = "10"

LAYERDEPENDS_musicbox-bsp = "raspberrypi"

LAYERSERIES_COMPAT_musicbox-bsp = "kirkstone"
```

## conf/machine/musicbox.conf
```bitbake
#@TYPE: Machine
#@NAME: MusicBox PI0w
#@DESCRIPTION: Machine configuration for the MusicBox

MACHINE = "musicbox"
MACHINEOVERRIDES =. "raspberrypi0-wifi:"

require conf/machine/raspberrypi0-wifi.conf

#
# RPi options
#
# Always turn on UART for debug
ENABLE_UART = "1"
# Enable u-boot bootloader
RPI_USE_U_BOOT = "1"
# Disable rpi boot logo
DISABLE_RPI_BOOT_LOGO = "1"
# Add I2C support
ENABLE_I2C = "1"
# Add SPI support
ENABLE_SPI_BUS = "1"
```
